## meta-arm/conf/layer.conf
```bitbake
# We have a conf and classes directory, add to BBPATH
BBPATH .= ":${LAYERDIR}"

# We have recipes-* directories, add to BBFILES
BBFILES += "${LAYERDIR}/recipes-*/*/*.bb \
            ${LAYERDIR}/recipes-*/*/*.bbappend"

BBFILE_COLLECTIONS += "meta-arm"
BBFILE_PATTERN_meta-arm = "^${LAYERDIR}/"
BBFILE_PRIORITY_meta-arm = "5"

BBMASK += "${LAYERDIR}/recipes-kernel"
BBMASK += "${LAYERDIR}/recipes-devtools/(?!opencsd)"
BBMASK += "${LAYERDIR}/recipes-bsp/u-boot"

LAYERDEPENDS_meta-arm = " \
    core \
"
LAYERSERIES_COMPAT_meta-arm = "nanbield scarthgap"

# runfvp --console needs telnet, so pull this in for testimage.
HOSTTOOLS_NONFATAL += "telnet"

addpylib ${LAYERDIR}/lib oeqa

WARN_QA:append:layer-meta-arm = " patch-status"
```
